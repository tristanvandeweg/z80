;Characters for the LCD
;Copyright (C) 2023-2024  Tristan van de Weg & Marijn Vollenberg
;
;    This program is free software; you can redistribute it and/or modify
;    it under the terms of the GNU General Public License as published by
;    the Free Software Foundation; either version 2 of the License, or
;    (at your option) any later version.
;
;    This program is distributed in the hope that it will be useful,
;    but WITHOUT ANY WARRANTY; without even the implied warranty of
;    MERCHANTABILITY or FITNESS FOR A PARTICULAR PURPOSE.  See the
;    GNU General Public License for more details.
;
;    You should have received a copy of the GNU General Public License along
;    with this program; if not, write to the Free Software Foundation, Inc.,
;    51 Franklin Street, Fifth Floor, Boston, MA 02110-1301 USA.

_FontStart .equ $1F00		;At the last part of ROM
_FontWidth .equ 4			;Font width in bits
_FontLength	.equ 2			;Font length in bytes

;--------------------------------
;Special Characters
;--------------------------------
.seek _FontStart+66

;!
.byte %01000100
.byte %00000100
;.%..
;.%..
;....
;.%..

;"
.byte %10101010
.byte %00000000
;%.%.
;%.%.
;....
;....

;# TODO
.byte %00000000
.byte %00000000
;
;
;
;

;$
.byte %0110110
.byte %00110110
;.%%.
;%%..
;.%%.
;%%..

;%
.byte %10010010
.byte %01001001
;%..%
;..%.
;.%..
;%..%

;& TODO
.byte %01000100
.byte %00000100
;.%%.
;.%%.
;%..%
;.%%%

;'
.byte %01000100
.byte %00000000
;.%..
;.%..
;....
;....

;(
.byte %01001000
.byte %10000100
;.%..
;%...
;%...
;.%..

;)
.byte %00100001
.byte %00010010
;..%.
;...%
;...%
;..%.

;*
.byte %00001000
.byte %00000000
;....
;.%..
;....
;....

;+
.byte %00000100
.byte %11100100
;....
;.%..
;%%%.
;.%..

;,
.byte %00000000
.byte %01001000
;....
;....
;.%..
;%...

;-
.byte %00000000
.byte %11100000
;....
;....
;%%%.
;....

;.
.byte %00000000
.byte %00001000
;....
;....
;....
;%...

;/
.byte %00010010
.byte %01001000
;...%
;..%.
;.%..
;%...

;--------------------------------
;Special Characters (2)
;--------------------------------
.seek _FontStart+116

;:
.byte %00000100
.byte %00000100
;....
;.%..
;....
;.%..

;;
.byte %01000000
.byte %01001000
;.%..
;....
;.%..
;%...

;<
.byte %00000110
.byte %10000110
;....
;.%%.
;%...
;.%%.

;=
.byte %00001111
.byte %00001111
;....
;%%%%
;....
;%%%%

;>
.byte %00000110
.byte %00010110
;....
;.%%.
;...%
;.%%.

;? TODO
.byte %01100110
.byte %00000100
;.%%.
;.%..
;....
;.%..

;@ TODO
.byte %01101001
.byte %10001110
;.%%.
;%..%
;%...
;%%%.

;--------------------------------
;Special Characters (3)
;--------------------------------
.seek _FontStart+246

;{
.byte %00100100
.byte %11000010
;..%.
;.%..
;%%..
;..%.

;|
.byte %01100110
.byte %01100110
;.%%.
;.%%.
;.%%.
;.%%.

;}
.byte %01000010
.byte %00110100
;.%..
;..%.
;..%%
;.%..

;~
.byte %00000101
.byte %10100000
;....
;.%.%
;%.%.
;....

;--------------------------------
;Numbers
;--------------------------------
.seek _FontStart+96

;0
.byte %01101011
.byte %11010110
;.%%.
;%.%%
;%%.%
;.%%.

;1
.byte %01100010
.byte %00100111
;.%%.
;..%.
;..%.
;.%%%

;2
.byte %01101001
.byte %00101111
;.%%.
;%..%
;..%.
;%%%%

;3
.byte %01110001
.byte %01110111
;.%%%
;...%
;.%%%
;.%%%

;4
.byte %01101010
.byte %11110010
;.%%.
;%.%.
;%%%%
;..%.

;5
.byte %11111110
.byte %00011110
;%%%%
;%%%.
;...%
;%%%.

;6
.byte %00010110
.byte %10011111
;...%
;.%%.
;%..%
;%%%%

;7
.byte %11110010
.byte %01001000
;%%%%
;..%.
;.%..
;%...

;8 TODO
.byte %10010110
.byte %10010110
;%..%
;.%%.
;%..%
;.%%.

;9
.byte %01110111
.byte %00100100
;.%%%
;.%%%
;..%.
;.%..



;--------------------------------
;Capital Font
;--------------------------------
.seek _FontStart+130

;A
.byte %01101001
.byte %11111001
;.%%.
;%..%
;%%%%
;%..%

;B TODO
.byte %11111101
.byte %10111111
;%%%%
;%%.%
;%.%%
;%%%%

;C
.byte %11111000
.byte %10001111
;%%%%
;%...
;%...
;%%%%

;D
.byte %11101001
.byte %10011110
;%%%.
;%..%
;%..%
;%%%.

;E
.byte %11111100
.byte %10001111
;%%%%
;%%..
;%...
;%%%%

;F
.byte %11111000
.byte %11101000
;%%%%
;%...
;%%%.
;%...

;G
.byte %11111000
.byte %10011111
;%%%%
;%...
;%..%
;%%%%

;H
.byte %10011111
.byte %10011001
;%..%
;%%%%
;%..%
;%..%

;I
.byte %11110110
.byte %01101111
;%%%%
;.%%.
;.%%.
;%%%%

;J
.byte %11110110
.byte %01101110
;%%%%
;.%%.
;.%%.
;%%%.

;K
.byte %11011110
.byte %11101101
;%%.%
;%%%.
;%%%.
;%%.%

;L
.byte %10001000
.byte %10001111
;%...
;%...
;%...
;%%%%

;M
.byte %10111111
.byte %11011001
;%.%%
;%%%%
;%%.%
;%..%

;N
.byte %10011101
.byte %10111001
;%..%
;%%.%
;%.%%
;%..%

;O
.byte %11111001
.byte %10011111
;%%%%
;%..%
;%..%
;%%%%

;P
.byte %11111001
.byte %11111000
;%%%%
;%..%
;%%%%
;%...

;Q
.byte %11111001
.byte %10111111
;%%%%
;%..%
;%.%%
;%%%%

;R
.byte %11111001
.byte %10101001
;%%%%
;%..%
;%.%.
;%..%

;S
.byte %11111100
.byte %00111111
;%%%%
;%%..
;..%%
;%%%%

;T
.byte %11110110
.byte %01100110
;%%%%
;.%%.
;.%%.
;.%%.

;U
.byte %10011001
.byte %10011111
;%..%
;%..%
;%..%
;%%%%

;V
.byte %10011001
.byte %10010110
;%..%
;%..%
;%..%
;.%%.

;W
.byte %10011011
.byte %11111101
;%..%
;%.%%
;%%%%
;%%.%

;X
.byte %10010110
.byte %01101001
;%..%
;.%%.
;.%%.
;%..%

;Y
.byte %10011111
.byte %01100110
;%..%
;%%%%
;.%%.
;.%%.

;Z
.byte %11110010
.byte %01001111
;%%%%
;..%.
;.%..
;%%%%

;--------------------------------
;Lowercase Font
;--------------------------------
.seek _FontStart+194

;A TODO
.byte %01101001
.byte %11111001
;.%%.
;%..%
;%%%%
;%..%

;b
.byte %10001110
.byte %10101110
;%...
;%%%.
;%.%.
;%%%.

;c
.byte %00001110
.byte %10001110
;....
;%%%.
;%...
;%%%.

;d
.byte %00010111
.byte %01010111
;...%
;.%%%
;.%.%
;.%%%

;e
.byte %01101111
.byte %10000110
;.%%.
;%%%%
;%...
;.%%.

;f
.byte %01101000
.byte %11101000
;.%%.
;%...
;%%%.
;%...

;g
.byte %11111111
.byte %00010111
;%%%%
;%%%%
;...%
;.%%%

;h
.byte %10001000
.byte %11111001
;%...
;%...
;%%%%
;%..%

;i
.byte %01000000
.byte %01000100
;.%..
;....
;.%..
;.%..

;j
.byte %00100000
.byte %00101110
;..%.
;....
;..%.
;%%%.

;k
.byte %10001010
.byte %11001010
;%...
;%.%.
;%%..
;%.%.

;l
.byte %01000100
.byte %01000100
;.%..
;.%..
;.%..
;.%..

;M TODO
.byte %10111111
.byte %11011001
;%.%%
;%%%%
;%%.%
;%..%

;n
.byte %00001110
.byte %10011001
;....
;%%%.
;%..%
;%..%

;o
.byte %00001110
.byte %10101110
;....
;%%%.
;%.%.
;%%%.

;p
.byte %11101010
.byte %11001000
;%%%.
;%.%.
;%%..
;%...

;q
.byte %01110101
.byte %00110001
;.%%%
;.%.%
;..%%
;...%

;r
.byte %00001110
.byte %10001000
;....
;%%%.
;%...
;%...

;s
.byte %00110100
.byte %00101100
;..%%
;.%..
;..%.
;%%..

;t
.byte %01001110
.byte %01000110
;.%..
;%%%.
;.%..
;.%%.

;u
.byte %00001001
.byte %10010111
;....
;%..%
;%..%
;.%%%

;v
.byte %00001001
.byte %10010110
;....
;%..%
;%..%
;.%%.

;W TODO
.byte %10011011
.byte %11111101
;%..%
;%.%%
;%%%%
;%%.%

;x
.byte %00001010
.byte %01001010
;....
;%.%.
;.%..
;%.%.

;y
.byte %01010111
.byte %00100100
;.%.%
;.%%%
;..%.
;.%..

;z
.byte %00001110
.byte %01101110
;....
;%%%.
;.%..
;%%%.
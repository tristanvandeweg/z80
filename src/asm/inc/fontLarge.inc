;Large 2x2 sprite font for the LCD
;Copyright (C) 2024  Tristan van de Weg & Marijn Vollenberg
;
;    This program is free software; you can redistribute it and/or modify
;    it under the terms of the GNU General Public License as published by
;    the Free Software Foundation; either version 2 of the License, or
;    (at your option) any later version.
;
;    This program is distributed in the hope that it will be useful,
;    but WITHOUT ANY WARRANTY; without even the implied warranty of
;    MERCHANTABILITY or FITNESS FOR A PARTICULAR PURPOSE.  See the
;    GNU General Public License for more details.
;
;    You should have received a copy of the GNU General Public License along
;    with this program; if not, write to the Free Software Foundation, Inc.,
;    51 Franklin Street, Fifth Floor, Boston, MA 02110-1301 USA.

_fontLarge
.echo ""
.echo "Large font starting address:	",_fontLarge

fl_FontDim .equ $22			;Font size in 4x4 sprites (2x2)

.byte fl_FontDim

;--------------------------------
;Jump Table
;--------------------------------
.dw fl_Char_excl	;!
.dw fl_Char_quot	;"
.dw fl_Char_pnd		;#
.dw fl_Char_dolr	;$
.dw fl_Char_pcnt	;%
.dw fl_Char_and		;&
.dw fl_Char_apos	;'
.dw fl_Char_lbra	;(
.dw fl_Char_rbra	;)
.dw fl_Char_ast		;*
.dw fl_Char_plus	;+
.dw fl_Char_comm	;,
.dw fl_Char_min		;-
.dw fl_Char_dot		;.
.dw fl_Char_slsh	;/

.dw fl_Num_0		;0
.dw fl_Num_1		;1
.dw fl_Num_2		;2
.dw fl_Num_3		;3
.dw fl_Num_4		;4
.dw fl_Num_5		;5
.dw fl_Num_6		;6
.dw fl_Num_7		;7
.dw fl_Num_8		;8
.dw fl_Num_9		;9

.dw fl_Char_col		;:
.dw fl_Char_scol	;;
.dw fl_Char_larr	;<
.dw fl_Char_eql 	;=
.dw fl_Char_rarr	;>
.dw fl_Char_ques	;?
.dw fl_Char_at		;@

.dw fl_Cap_a		;A
.dw fl_Cap_b		;B
.dw fl_Cap_c		;C
.dw fl_Cap_d		;D
.dw fl_Cap_e		;E
.dw fl_Cap_f		;F
.dw fl_Cap_g		;G
.dw fl_Cap_h		;H
.dw fl_Cap_i		;I
.dw fl_Cap_j		;J
.dw fl_Cap_k		;K
.dw fl_Cap_l		;L
.dw fl_Cap_m		;M
.dw fl_Cap_n		;N
.dw fl_Cap_o		;O
.dw fl_Cap_p		;P
.dw fl_Cap_q		;Q
.dw fl_Cap_r		;R
.dw fl_Cap_s		;S
.dw fl_Cap_t		;T
.dw fl_Cap_u		;U
.dw fl_Cap_v		;V
.dw fl_Cap_w		;W
.dw fl_Cap_x		;X
.dw fl_Cap_y		;Y
.dw fl_Cap_z		;Z

.dw fl_Char_lsbr	;[
.dw fl_Char_bsl		;\
.dw fl_Char_rsbr	;]
.dw fl_Char_uarr	;^
.dw fl_Char_lmin	;_
.dw fl_Char_gve		;`

.dw fl_Low_a		;a
.dw fl_Low_b		;b
.dw fl_Low_c		;c
.dw fl_Low_d		;d
.dw fl_Low_e		;e
.dw fl_Low_f		;f
.dw fl_Low_g		;g
.dw fl_Low_h		;h
.dw fl_Low_i		;i
.dw fl_Low_j		;j
.dw fl_Low_k		;k
.dw fl_Low_l		;l
.dw fl_Low_m		;m
.dw fl_Low_n		;n
.dw fl_Low_o		;o
.dw fl_Low_p		;p
.dw fl_Low_q		;q
.dw fl_Low_r		;r
.dw fl_Low_s		;s
.dw fl_Low_t		;t
.dw fl_Low_u		;u
.dw fl_Low_v		;v
.dw fl_Low_w		;w
.dw fl_Low_x		;x
.dw fl_Low_y		;y
.dw fl_Low_z		;z

fl__CharStart
.echo "Start of characters:	",fl__CharStart

;--------------------------------
;Special Characters
;--------------------------------

;Missing character
fl_Char_excl:
fl_Char_quot:
fl_Char_pnd:
fl_Char_dolr:
fl_Char_pcnt:
fl_Char_and:
fl_Char_apos:
fl_Char_lbra:
fl_Char_rbra:
fl_Char_ast:
fl_Char_plus:
fl_Char_comm:
fl_Char_min:
fl_Char_dot:
fl_Char_slsh:

fl_Num_0:
fl_Num_1:
fl_Num_2:
fl_Num_3:
fl_Num_4:
fl_Num_5:
fl_Num_6:
fl_Num_7:
fl_Num_8:
fl_Num_9:

fl_Char_col:
fl_Char_scol:
fl_Char_larr:
fl_Char_eql:
fl_Char_rarr:
fl_Char_ques:
fl_Char_at:

fl_Char_lsbr:
fl_Char_bsl:
fl_Char_rsbr:
fl_Char_uarr:
fl_Char_lmin:
fl_Char_gve:
.byte %11011010	;%%.% 1101
.byte %10100000	;%.%. 1010
				;%.%. 1010
				;.... 0000

.byte %10001000	;%... 1000
.byte %10000000	;%... 1000
				;%... 1000
				;.... 0000

.byte %00000000	;.... 0000
.byte %00000000	;.... 0000
				;.... 0000
				;.... 0000

.byte %01111000	;.%%% 0111
.byte %10000111	;%... 1000
				;%... 1000
				;.%%% 0111

;........
;%%.%%...
;%.%.%...
;%.%.%...
;.....%%%
;....%...
;....%...
;.....%%%

;--------------------------------
;Capital Letters
;--------------------------------

;A
fl_Cap_a:
.byte %00000011	;....
.byte %01000100	;..%%
				;.%..
				;.%..

.byte %00001100	;....
.byte %00100010	;%%..
				;..%.
				;..%.

.byte %01110100	;.%%%
.byte %01000100	;.%..
				;.%..
				;.%..

.byte %11100010	;%%%.
.byte %00100010	;..%.
				;..%.
				;..%.

;........
;..%%%%..
;.%....%.
;.%....%.
;.%%%%%%.
;.%....%.
;.%....%.
;.%....%.

;B
fl_Cap_b:
.byte %00000111	;....
.byte %01000100	;.%%%
				;.%..
				;.%..

.byte %00001100	;....
.byte %00100010	;%%..
				;..%.
				;..%.

.byte %01110100	;.%%%
.byte %01000111	;.%..
				;.%..
				;.%%%

.byte %11000010	;%%..
.byte %00101100	;..%.
				;..%.
				;%%..

;........
;.%%%%%..
;.%....%.
;.%....%.
;.%%%%%..
;.%....%.
;.%....%.
;.%%%%%..

;C
fl_Cap_c:
.byte %00000011	;.... 0000
.byte %01000100	;..%% 0011
				;.%.. 0100
				;.%.. 0100

.byte %00001100	;.... 0000
.byte %00000000	;%%.. 1100
				;.... 0000
				;.... 0000

.byte %01000100	;.%.. 0100
.byte %01000011	;.%.. 0100
				;.%.. 0100
				;..%% 0011

.byte %00000000	;.... 0000
.byte %00001100	;.... 0000
				;.... 0000
				;%%.. 1100

;........
;..%%%%..
;.%......
;.%......
;.%......
;.%......
;.%......
;..%%%%..

;D
fl_Cap_d:
.byte %00000111	;.... 0000
.byte %01000100	;.%%% 0111
				;.%.. 0100
				;.%.. 0100

.byte %00001100	;.... 0000
.byte %00100010	;%%.. 1100
				;..%. 0010
				;..%. 0010

.byte %01000100	;.%.. 0100
.byte %01000111	;.%.. 0100
				;.%.. 0100
				;.%%% 0111

.byte %00100010	;..%. 0010
.byte %00101100	;..%. 0010
				;..%. 0010
				;%%.. 1100

;........
;.%%%%%..
;.%....%.
;.%....%.
;.%....%.
;.%....%.
;.%....%.
;.%%%%%..

;E
fl_Cap_e:
.byte %00000111	;.... 0000
.byte %01000100	;.%%% 0111
				;.%.. 0100
				;.%.. 0100

.byte %00001100	;.... 0000
.byte %00000000	;%%.. 1100
				;.... 0000
				;.... 0000

.byte %01110100	;.%%% 0111
.byte %01000111	;.%.. 0100
				;.%.. 0100
				;.%%% 0111

.byte %11000000	;%%.. 1100
.byte %00001100	;.... 0000
				;.... 0000
				;%%.. 1100

;........
;.%%%%%..
;.%......
;.%......
;.%%%%%..
;.%......
;.%......
;.%%%%%..

;F
fl_Cap_f:
.byte %00000111	;.... 0000
.byte %01000100	;.%%% 0111
				;.%.. 0100
				;.%.. 0100

.byte %00001100	;.... 0000
.byte %00000000	;%%.. 1100
				;.... 0000
				;.... 0000

.byte %01110100	;.%%%
.byte %01000100	;.%..
				;.%..
				;.%..

.byte %11000000	;%%.. 1100
.byte %00000000	;.... 0000
				;.... 0000
				;.... 0000

;........
;.%%%%%..
;.%......
;.%......
;.%%%%%..
;.%......
;.%......
;.%......

;G
fl_Cap_g:
.byte %00000011	;.... 0000
.byte %01000100	;..%% 0011
				;.%.. 0100
				;.%.. 0100

.byte %00001100	;.... 0000
.byte %00000000	;%%.. 1100
				;.... 0000
				;.... 0000

.byte %01000100	;.%.. 0100
.byte %0100011	;.%.. 0100
				;.%.. 0100
				;..%% 0011

.byte %01000010	;.%%. 0110
.byte %00101110	;..%. 0010
				;..%. 0010
				;%%%. 1110

;........
;..%%%%..
;.%......
;.%......
;.%...%%.
;.%....%.
;.%....%.
;..%%%%%.

;H
fl_Cap_h:
.byte %00000100	;.... 0000
.byte %01000100	;.%.. 0100
				;.%.. 0100
				;.%.. 0100

.byte %00000010	;.... 0000
.byte %00100010	;..%. 0010
				;..%. 0010
				;..%. 0010

.byte %01110100	;.%%% 0111
.byte %01000100	;.%.. 0100
				;.%.. 0100
				;.%.. 0100

.byte %11100010	;%%%. 1110
.byte %00100010	;..%. 0010
				;..%. 0010
				;..%. 0010

;........
;.%....%.
;.%....%.
;.%....%.
;.%%%%%%.
;.%....%.
;.%....%.
;.%....%.

;I TODO:
fl_Cap_i:
.byte %00000111	;....
.byte %01000100	;.%%%
				;.%..
				;.%..

.byte %00001100	;....
.byte %00100010	;%%..
				;..%.
				;..%.

.byte %01110100	;.%%%
.byte %01000111	;.%..
				;.%..
				;.%%%

.byte %11000010	;%%..
.byte %00101100	;..%.
				;..%.
				;%%..

;........
;.%%%%%..
;...%....
;...%....
;...%....
;...%....
;...%....
;.%%%%%..

;J TODO:
fl_Cap_j:
.byte %00000111	;....
.byte %01000100	;.%%%
				;.%..
				;.%..

.byte %00001100	;....
.byte %00100010	;%%..
				;..%.
				;..%.

.byte %01110100	;.%%%
.byte %01000111	;.%..
				;.%..
				;.%%%

.byte %11000010	;%%..
.byte %00101100	;..%.
				;..%.
				;%%..

;........
;..%%%%%.
;....%...
;....%...
;....%...
;....%...
;....%...
;..%%%...

;K TODO:
fl_Cap_k:
.byte %00000111	;....
.byte %01000100	;.%%%
				;.%..
				;.%..

.byte %00001100	;....
.byte %00100010	;%%..
				;..%.
				;..%.

.byte %01110100	;.%%%
.byte %01000111	;.%..
				;.%..
				;.%%%

.byte %11000010	;%%..
.byte %00101100	;..%.
				;..%.
				;%%..

;........
;.%...%..
;.%..%...
;.%.%....
;.%%.....
;.%.%....
;.%..%...
;.%...%..

;L
fl_Cap_l:
.byte %00000100	;.... 0000
.byte %01000100	;.%.. 0100
				;.%.. 0100
				;.%.. 0100

.byte %00000000	;.... 0000
.byte %00000000	;.... 0000
				;.... 0000
				;.... 0000

.byte %01000100	;.%.. 0100
.byte %01000111	;.%.. 0100
				;.%.. 0100
				;.%%% 0111

.byte %00000000	;.... 0000
.byte %00001110	;.... 0000
				;.... 0000
				;%%%. 1110

;........
;.%......
;.%......
;.%......
;.%......
;.%......
;.%......
;.%%%%%%.

;M TODO:
fl_Cap_m:
.byte %00000111	;....
.byte %01000100	;.%%%
				;.%..
				;.%..

.byte %00001100	;....
.byte %00100010	;%%..
				;..%.
				;..%.

.byte %01110100	;.%%%
.byte %01000111	;.%..
				;.%..
				;.%%%

.byte %11000010	;%%..
.byte %00101100	;..%.
				;..%.
				;%%..

;........
;........
;.%....%.
;.%%..%%.
;.%.%%.%.
;.%....%.
;.%....%.
;.%....%.

;N
fl_Cap_n:
.byte %00001000	;.... 0000
.byte %11001010	;%... 1000
				;%%.. 1100
				;%.%. 1010

.byte %00000010	;.... 0000
.byte %00100010	;..%. 0010
				;..%. 0010
				;..%. 0010

.byte %10011000	;%..% 1001
.byte %10001000	;%... 1000
				;%... 1000
				;%... 1000

.byte %00101010	;..%. 0010
.byte %01100010	;%.%. 1010
				;.%%. 0110
				;..%. 0010

;........
;%.....%.
;%%....%.
;%.%...%.
;%..%..%.
;%...%.%.
;%....%%.
;%.....%.

;O
fl_Cap_o:
.byte %00000011	;.... 0000
.byte %01001000	;..%% 0011
				;.%.. 0100
				;%... 1000

.byte %00001100	;.... 0000
.byte %00100001	;%%.. 1100
				;..%. 0010
				;...% 0001

.byte %10001000	;%... 1000
.byte %01000011	;%... 1000
				;.%.. 0100
				;..%% 0011

.byte %00010001	;...% 0001
.byte %00101100	;...% 0001
				;..%. 0010
				;%%.. 1100

;........
;..%%%%..
;.%....%.
;%......%
;%......%
;%......%
;.%....%.
;..%%%%..

;P TODO:
fl_Cap_p:
.byte %00000111	;....
.byte %01000100	;.%%%
				;.%..
				;.%..

.byte %00001100	;....
.byte %00100010	;%%..
				;..%.
				;..%.

.byte %01110100	;.%%%
.byte %01000111	;.%..
				;.%..
				;.%%%

.byte %11000010	;%%..
.byte %00101100	;..%.
				;..%.
				;%%..

;........
;.%%%%%..
;.%....%.
;.%....%.
;.%%%%%..
;.%......
;.%......
;.%......

;Q TODO:
fl_Cap_q:
.byte %00000111	;....
.byte %01000100	;.%%%
				;.%..
				;.%..

.byte %00001100	;....
.byte %00100010	;%%..
				;..%.
				;..%.

.byte %01110100	;.%%%
.byte %01000111	;.%..
				;.%..
				;.%%%

.byte %11000010	;%%..
.byte %00101100	;..%.
				;..%.
				;%%..

;........
;..%%%%..
;.%....%.
;%......%
;%......%
;%....%.%
;.%....%.
;..%%%%.%

;R
fl_Cap_r:
.byte %00000111	;.... 0000
.byte %01000100	;.%%% 0111
				;.%.. 0100
				;.%.. 0100

.byte %00001100	;.... 0000
.byte %00100010	;%%.. 1100
				;..%. 0010
				;..%. 0010

.byte %01110100	;.%%% 0111
.byte %01000100	;.%.. 0100
				;.%.. 0100
				;.%.. 0100

.byte %11001000	;%%.. 1100
.byte %01000010	;%... 1000
				;.%.. 0100
				;..%. 0010

;........
;.%%%%%..
;.%....%.
;.%....%.
;.%%%%%..
;.%..%...
;.%...%..
;.%....%.

;S TODO:
fl_Cap_s:
.byte %00000111	;....
.byte %01000100	;.%%%
				;.%..
				;.%..

.byte %00001100	;....
.byte %00100010	;%%..
				;..%.
				;..%.

.byte %01110100	;.%%%
.byte %01000111	;.%..
				;.%..
				;.%%%

.byte %11000010	;%%..
.byte %00101100	;..%.
				;..%.
				;%%..

;........
;..%%%%%.
;.%......
;.%......
;..%%%%..
;......%.
;......%.
;.%%%%%..

;T TODO:
fl_Cap_t:
.byte %00000111	;....
.byte %01000100	;.%%%
				;.%..
				;.%..

.byte %00001100	;....
.byte %00100010	;%%..
				;..%.
				;..%.

.byte %01110100	;.%%%
.byte %01000111	;.%..
				;.%..
				;.%%%

.byte %11000010	;%%..
.byte %00101100	;..%.
				;..%.
				;%%..

;........
;%%%%%%%.
;...%....
;...%....
;...%....
;...%....
;...%....
;...%....

;U TODO:
fl_Cap_u:
.byte %00000111	;....
.byte %01000100	;.%%%
				;.%..
				;.%..

.byte %00001100	;....
.byte %00100010	;%%..
				;..%.
				;..%.

.byte %01110100	;.%%%
.byte %01000111	;.%..
				;.%..
				;.%%%

.byte %11000010	;%%..
.byte %00101100	;..%.
				;..%.
				;%%..

;........
;.%....%.
;.%....%.
;.%....%.
;.%....%.
;.%....%.
;.%....%.
;..%%%%%.

;V TODO:
fl_Cap_v:
.byte %00000111	;....
.byte %01000100	;.%%%
				;.%..
				;.%..

.byte %00001100	;....
.byte %00100010	;%%..
				;..%.
				;..%.

.byte %01110100	;.%%%
.byte %01000111	;.%..
				;.%..
				;.%%%

.byte %11000010	;%%..
.byte %00101100	;..%.
				;..%.
				;%%..

;........
;.%....%.
;.%....%.
;.%....%.
;.%....%.
;.%....%.
;..%..%..
;...%%...

;W
fl_Cap_w:
.byte %00001000	;.... 0000
.byte %10001000	;%... 1000
				;%... 1000
				;%... 1000

.byte %00000100	;.... 0000
.byte %01000100	;.%.. 0100
				;.%.. 0100
				;.%.. 0100

.byte %10001000	;%... 1000
.byte %10110100	;%... 1000
				;%.%% 1011
				;.%.. 0100

.byte %01000100	;.%.. 0100
.byte %01001000	;.%.. 0100
				;.%.. 0100
				;%... 1000

;........
;%....%..
;%....%..
;%....%..
;%....%..
;%....%..
;%.%%.%..
;.%..%...

;X
fl_Cap_x:
.byte %00001000	;.... 0000
.byte %01000010	;%... 1000
				;.%.. 0100
				;..%. 0010

.byte %00000010	;.... 0000
.byte %01001000	;..%. 0010
				;.%.. 0100
				;%... 1000

.byte %00010010	;...% 0001
.byte %01001000	;..%. 0010
				;.%.. 0100
				;%... 1000

.byte %00001000	;.... 0000
.byte %01000010	;%... 1000
				;.%.. 0100
				;..%. 0010

;........
;%.....%.
;.%...%..
;..%.%...
;...%....
;..%.%...
;.%...%..
;%.....%.

;Y
fl_Cap_y:
.byte %00001000	;.... 0000
.byte %01000010	;%... 1000
				;.%.. 0100
				;..%. 0010

.byte %00000010	;.... 0000
.byte %01001000	;..%. 0010
				;.%.. 0100
				;%... 1000

.byte %00010001	;...% 0001
.byte %00010001	;...% 0001
				;...% 0001
				;...% 0001

.byte %00000000	;.... 0000
.byte %00000000	;.... 0000
				;.... 0000
				;.... 0000

;........
;%.....%.
;.%...%..
;..%.%...
;...%....
;...%....
;...%....
;...%....

;Z
fl_Cap_z:
.byte %00001111	;.... 0000
.byte %00000000	;%%%% 1111
				;.... 0000
				;.... 0000

.byte %00001110	;.... 0000
.byte %01001000	;%%%. 1110
				;.%.. 0100
				;%... 1000

.byte %00010010	;...% 0001
.byte %01001111	;..%. 0010
				;.%.. 0100
				;%%%% 1111

.byte %00000000	;.... 0000
.byte %00001110	;.... 0000
				;.... 0000
				;%%%. 1110

;........
;%%%%%%%.
;.....%..
;....%...
;...%....
;..%.....
;.%......
;%%%%%%%.

;--------------------------------
;Lowercase Letters
;--------------------------------

;a
fl_Low_a:
.byte %00000000	;.... 0000
.byte %00000000	;.... 0000
				;.... 0000
				;.... 0000

.byte %00000000	;.... 0000
.byte %00000000	;.... 0000
				;.... 0000
				;.... 0000

.byte %00110100	;..%% 0011
.byte %01000011	;.%.. 0100
				;.%.. 0100
				;..%% 0011

.byte %11100010	;%%%. 1110
.byte %00101111	;..%. 0010
				;..%. 0010
				;%%%% 1111

;........
;........
;........
;........
;..%%%%%.
;.%....%.
;.%....%.
;..%%%%%%

;b
fl_Low_b:
.byte %00000100	;.... 0000
.byte %01000100	;.%.. 0100
				;.%.. 0100
				;.%.. 0100

.byte %00000000	;.... 0000
.byte %00000000	;.... 0000
				;.... 0000
				;.... 0000

.byte %01110100	;.%%% 0111
.byte %01000100	;.%.. 0100
				;.%.. 0100
				;.%%% 0100

.byte %10000100	;%... 1000
.byte %01001000	;.%.. 0100
				;.%.. 0100
				;%... 1000

;........
;.%......
;.%......
;.%......
;.%%%%...
;.%...%..
;.%...%..
;.%%%%...

;c TODO:
fl_Low_c:
.byte %00000011	;.... 0000
.byte %01000100	;..%% 0011
				;.%.. 0100
				;.%.. 0100

.byte %00001100	;.... 0000
.byte %00000000	;%%.. 1100
				;.... 0000
				;.... 0000

.byte %01000100	;.%.. 0100
.byte %01000011	;.%.. 0100
				;.%.. 0100
				;..%% 0011

.byte %00000000	;.... 0000
.byte %00001100	;.... 0000
				;.... 0000
				;%%.. 1100

;........
;..%%%%..
;.%......
;.%......
;.%......
;.%......
;.%......
;..%%%%..

;d
fl_Low_d:
.byte %00000000	;.... 0000
.byte %00000000	;.... 0000
				;.... 0000
				;.... 0000

.byte %00000100	;.... 0000
.byte %01000100	;.%.. 0100
				;.%.. 0100
				;.%.. 0100

.byte %00110100	;..%% 0011
.byte %01000011	;.%.. 0100
				;.%.. 0100
				;..%% 0011

.byte %11000010	;%%.. 1100
.byte %00101100	;.%.. 0010
				;.%.. 0010
				;%%.. 1100

;........
;.....%..
;.....%..
;.....%..
;..%%%%..
;.%...%..
;.%...%..
;..%%%%..

;e TODO:
fl_Low_e:
.byte %00000111	;.... 0000
.byte %01000100	;.%%% 0111
				;.%.. 0100
				;.%.. 0100

.byte %00001100	;.... 0000
.byte %00000000	;%%.. 1100
				;.... 0000
				;.... 0000

.byte %01110100	;.%%% 0111
.byte %01000111	;.%.. 0100
				;.%.. 0100
				;.%%% 0111

.byte %11000000	;%%.. 1100
.byte %00001100	;.... 0000
				;.... 0000
				;%%.. 1100

;........
;.%%%%%..
;.%......
;.%......
;.%%%%%..
;.%......
;.%......
;.%%%%%..

;f
fl_Low_f:
.byte %00000001	;.... 0000
.byte %00100010	;...% 0001
				;..%. 0010
				;..%. 0010

.byte %00001110	;.... 0000
.byte %00000000	;%%%. 1110
				;.... 0000
				;.... 0000

.byte %01110010	;.%%% 0111
.byte %00100010	;..%. 0010
				;..%. 0010
				;..%. 0010

.byte %10000000	;%... 1000
.byte %00000000	;.... 0000
				;.... 0000
				;.... 0000

;........
;...%%%%.
;..%.....
;..%.....
;.%%%%...
;..%.....
;..%.....
;..%.....

;g TODO:
fl_Low_g:
.byte %00000011	;.... 0000
.byte %01000100	;..%% 0011
				;.%.. 0100
				;.%.. 0100

.byte %00001100	;.... 0000
.byte %00000000	;%%.. 1100
				;.... 0000
				;.... 0000

.byte %01000100	;.%.. 0100
.byte %0100011	;.%.. 0100
				;.%.. 0100
				;..%% 0011

.byte %01000010	;.%%. 0110
.byte %00101110	;..%. 0010
				;..%. 0010
				;%%%. 1110

;........
;..%%%%..
;.%......
;.%......
;.%...%%.
;.%....%.
;.%....%.
;..%%%%%.

;h TODO:
fl_Low_h:
.byte %00000100	;.... 0000
.byte %01000100	;.%.. 0100
				;.%.. 0100
				;.%.. 0100

.byte %00000010	;.... 0000
.byte %00100010	;..%. 0010
				;..%. 0010
				;..%. 0010

.byte %01110100	;.%%% 0111
.byte %01000100	;.%.. 0100
				;.%.. 0100
				;.%.. 0100

.byte %11100010	;%%%. 1110
.byte %00100010	;..%. 0010
				;..%. 0010
				;..%. 0010

;........
;.%....%.
;.%....%.
;.%....%.
;.%%%%%%.
;.%....%.
;.%....%.
;.%....%.

;i
fl_Low_i:
.byte %00000000	;.... 0000
.byte %00000001	;.... 0000
				;.... 0000
				;...% 0001

.byte %00000000	;.... 0000
.byte %00000000	;.... 0000
				;.... 0000
				;.... 0000

.byte %00000001	;.... 0000
.byte %00010001	;...% 0001
				;...% 0001
				;...% 0001

.byte %00000000	;.... 0000
.byte %00000000	;.... 0000
				;.... 0000
				;.... 0000

;........
;........
;........
;...%....
;........
;...%....
;...%....
;...%....

;j TODO:
fl_Low_j:
.byte %00000111	;....
.byte %01000100	;.%%%
				;.%..
				;.%..

.byte %00001100	;....
.byte %00100010	;%%..
				;..%.
				;..%.

.byte %01110100	;.%%%
.byte %01000111	;.%..
				;.%..
				;.%%%

.byte %11000010	;%%..
.byte %00101100	;..%.
				;..%.
				;%%..

;........
;..%%%%%.
;....%...
;....%...
;....%...
;....%...
;....%...
;..%%%...

;k TODO:
fl_Low_k:
.byte %00000111	;....
.byte %01000100	;.%%%
				;.%..
				;.%..

.byte %00001100	;....
.byte %00100010	;%%..
				;..%.
				;..%.

.byte %01110100	;.%%%
.byte %01000111	;.%..
				;.%..
				;.%%%

.byte %11000010	;%%..
.byte %00101100	;..%.
				;..%.
				;%%..

;........
;.%...%..
;.%..%...
;.%.%....
;.%%.....
;.%.%....
;.%..%...
;.%...%..

;l TODO:
fl_Low_l:
.byte %00000100	;.... 0000
.byte %01000100	;.%.. 0100
				;.%.. 0100
				;.%.. 0100

.byte %00000000	;.... 0000
.byte %00000000	;.... 0000
				;.... 0000
				;.... 0000

.byte %01000100	;.%.. 0100
.byte %01000111	;.%.. 0100
				;.%.. 0100
				;.%%% 0111

.byte %00000000	;.... 0000
.byte %00001110	;.... 0000
				;.... 0000
				;%%%. 1110

;........
;.%......
;.%......
;.%......
;.%......
;.%......
;.%......
;.%%%%%%.

;m TODO:
fl_Low_m:
.byte %00000111	;....
.byte %01000100	;.%%%
				;.%..
				;.%..

.byte %00001100	;....
.byte %00100010	;%%..
				;..%.
				;..%.

.byte %01110100	;.%%%
.byte %01000111	;.%..
				;.%..
				;.%%%

.byte %11000010	;%%..
.byte %00101100	;..%.
				;..%.
				;%%..

;........
;........
;.%....%.
;.%%..%%.
;.%.%%.%.
;.%....%.
;.%....%.
;.%....%.

;n
fl_Low_n:
.byte %00000000	;.... 0000
.byte %00001011	;.... 0000
				;.... 0000
				;%.%% 1011

.byte %00000000	;.... 0000
.byte %00001100	;.... 0000
				;.... 0000
				;%%.. 1100

.byte %11001000	;%%.. 1100
.byte %10001000	;%... 1000
				;%... 1000
				;%... 1000

.byte %00100010	;..%. 0010
.byte %00100010	;..%. 0010
				;..%. 0010
				;..%. 0010

;........
;........
;........
;%.%%%%..
;%%....%.
;%.....%.
;%.....%.
;%.....%.

;o
fl_Low_o:
.byte %00000000	;.... 0000
.byte %00000011	;.... 0000
				;.... 0000
				;..%% 0011

.byte %00000000	;.... 0000
.byte %00001100	;.... 0000
				;.... 0000
				;%%.. 1100

.byte %01000100	;.%.. 0100
.byte %01000011	;.%.. 0100
				;.%.. 0100
				;..%% 0011

.byte %00100010	;..%. 0010
.byte %00101100	;..%. 0010
				;..%. 0010
				;%%.. 1100

;........
;........
;........
;..%%%%..
;.%....%.
;.%....%.
;.%....%.
;..%%%%..

;p
fl_Low_p:
.byte %00000000	;.... 0000
.byte %01110100	;.... 0000
				;.%%% 0111
				;.%.. 0100

.byte %00000000	;.... 0000
.byte %00001000	;.... 0000
				;.... 0000
				;%... 1000

.byte %01000111	;.%.. 0100
.byte %01000100	;.%%% 0111
				;.%.. 0100
				;.%.. 0100

.byte %10000000	;%... 1000
.byte %00000000	;.... 0000
				;.... 0000
				;.... 0000

;........
;........
;.%%%....
;.%..%...
;.%..%...
;.%%%....
;.%......
;.%......

;q TODO:
fl_Low_q:
.byte %00000111	;....
.byte %01000100	;.%%%
				;.%..
				;.%..

.byte %00001100	;....
.byte %00100010	;%%..
				;..%.
				;..%.

.byte %01110100	;.%%%
.byte %01000111	;.%..
				;.%..
				;.%%%

.byte %11000010	;%%..
.byte %00101100	;..%.
				;..%.
				;%%..

;........
;..%%%%..
;.%....%.
;%......%
;%......%
;%....%.%
;.%....%.
;..%%%%.%

;r
fl_Low_r:
.byte %00000000	;.... 0000
.byte %00000101	;.... 0000
				;.... 0000
				;.%.% 0101

.byte %00000000	;.... 0000
.byte %00001100	;.... 0000
				;.... 0000
				;%%.. 1100

.byte %01100100	;.%%. 0110
.byte %01000100	;.%.. 0100
				;.%.. 0100
				;.%.. 0100

.byte %00000000	;.... 0000
.byte %00000000	;.... 0000
				;.... 0000
				;.... 0000

;........
;........
;........
;.%.%%%..
;.%%.....
;.%......
;.%......
;.%......

;s TODO:
fl_Low_s:
.byte %00000111	;....
.byte %01000100	;.%%%
				;.%..
				;.%..

.byte %00001100	;....
.byte %00100010	;%%..
				;..%.
				;..%.

.byte %01110100	;.%%%
.byte %01000111	;.%..
				;.%..
				;.%%%

.byte %11000010	;%%..
.byte %00101100	;..%.
				;..%.
				;%%..

;........
;..%%%%%.
;.%......
;.%......
;..%%%%..
;......%.
;......%.
;.%%%%%..

;t TODO:
fl_Low_t:
.byte %00000111	;....
.byte %01000100	;.%%%
				;.%..
				;.%..

.byte %00001100	;....
.byte %00100010	;%%..
				;..%.
				;..%.

.byte %01110100	;.%%%
.byte %01000111	;.%..
				;.%..
				;.%%%

.byte %11000010	;%%..
.byte %00101100	;..%.
				;..%.
				;%%..

;........
;%%%%%%%.
;...%....
;...%....
;...%....
;...%....
;...%....
;...%....

;u TODO:
fl_Low_u:
.byte %00000111	;....
.byte %01000100	;.%%%
				;.%..
				;.%..

.byte %00001100	;....
.byte %00100010	;%%..
				;..%.
				;..%.

.byte %01110100	;.%%%
.byte %01000111	;.%..
				;.%..
				;.%%%

.byte %11000010	;%%..
.byte %00101100	;..%.
				;..%.
				;%%..

;........
;.%....%.
;.%....%.
;.%....%.
;.%....%.
;.%....%.
;.%....%.
;..%%%%%.

;v TODO:
fl_Low_v:
.byte %00000111	;....
.byte %01000100	;.%%%
				;.%..
				;.%..

.byte %00001100	;....
.byte %00100010	;%%..
				;..%.
				;..%.

.byte %01110100	;.%%%
.byte %01000111	;.%..
				;.%..
				;.%%%

.byte %11000010	;%%..
.byte %00101100	;..%.
				;..%.
				;%%..

;........
;.%....%.
;.%....%.
;.%....%.
;.%....%.
;.%....%.
;..%..%..
;...%%...

;w TODO:
fl_Low_w:
.byte %00001000	;.... 0000
.byte %10001000	;%... 1000
				;%... 1000
				;%... 1000

.byte %00000100	;.... 0000
.byte %01000100	;.%.. 0100
				;.%.. 0100
				;.%.. 0100

.byte %10001000	;%... 1000
.byte %10110100	;%... 1000
				;%.%% 1011
				;.%.. 0100

.byte %01000100	;.%.. 0100
.byte %01001000	;.%.. 0100
				;.%.. 0100
				;%... 1000

;........
;%....%..
;%....%..
;%....%..
;%....%..
;%....%..
;%.%%.%..
;.%..%...

;x TODO:
fl_Low_x:
.byte %00001000	;.... 0000
.byte %01000010	;%... 1000
				;.%.. 0100
				;..%. 0010

.byte %00000010	;.... 0000
.byte %01001000	;..%. 0010
				;.%.. 0100
				;%... 1000

.byte %00010010	;...% 0001
.byte %01001000	;..%. 0010
				;.%.. 0100
				;%... 1000

.byte %00001000	;.... 0000
.byte %01000010	;%... 1000
				;.%.. 0100
				;..%. 0010

;........
;%.....%.
;.%...%..
;..%.%...
;...%....
;..%.%...
;.%...%..
;%.....%.

;y
fl_Low_y:
.byte %00000000	;.... 0000
.byte %00000100	;.... 0000
				;.... 0000
				;.%.. 0100

.byte %00000000	;.... 0000
.byte %00000100	;.... 0000
				;.... 0000
				;.%.. 0100

.byte %00100001	;..%. 0010
.byte %00010001	;...% 0001
				;...% 0001
				;...% 0001

.byte %10000000	;%... 1000
.byte %00000000	;.... 0000
				;.... 0000
				;.... 0000

;........
;........
;........
;.%...%..
;..%.%...
;...%....
;...%....
;...%....

;z
fl_Low_z:
.byte %00000000	;.... 0000
.byte %00000111	;.... 0000
				;.... 0000
				;.%%% 0111

.byte %00000000	;.... 0000
.byte %00001100	;.... 0000
				;.... 0000
				;%%.. 1100

.byte %00000001	;.... 0000
.byte %00100111	;...% 0001
				;..%. 0010
				;.%%% 0111

.byte %10000000	;%... 1000
.byte %00001100	;.... 0000
				;.... 0000
				;%%.. 1100

;........
;........
;........
;.%%%%%..
;....%...
;...%....
;..%.....
;.%%%%%..

fl__FontEnd
.echo "Large font jump table size:	",fl__CharStart-_fontLarge
.echo "Large font sprite size:	",fl__FontEnd-fl__CharStart
.echo "Large font total size:	",fl__FontEnd-_fontLarge

.echo ""